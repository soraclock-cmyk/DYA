## config/west.yml
```yaml
manifest:
  remotes:
    - name: cormoran
      url-base: https://github.com/cormoran
    - name: badjeff
      url-base: https://github.com/badjeff
    - name: caksoylar
      url-base: https://github.com/caksoylar

  projects:
    # DYA Studio対応 ZMK (cormoran fork)
    - name: zmk
      remote: cormoran
      revision: v0.3-branch+dya
      import: app/west.yml

    # DYA Studio モジュール群
    - name: zmk-module-ble-management
      remote: cormoran
      revision: main

    - name: zmk-module-battery-history
      remote: cormoran
      revision: main

    - name: zmk-module-settings-rpc
      remote: cormoran
      revision: main

    - name: zmk-module-runtime-input-processor
      remote: cormoran
      revision: main

    - name: zmk-behavior-runtime-sensor-rotate
      remote: cormoran
      revision: main

    # PMW3610 トラックボールドライバー
    - name: zmk-pmw3610-driver
      remote: badjeff
      revision: zmk-0.3

    # RGB LED ウィジェット
    # 0efe481: zmk_endpoints_selected() API使用 → cormoran v0.3-branch+dya と互換
    # d9b8ab6以降は zmk_endpoint_get_selected() に戻り非互換になるため固定
    - name: zmk-rgbled-widget
      remote: caksoylar
      revision: 0efe4813489edae53781e3a0715204840ac59076

  self:
    path: config
```
